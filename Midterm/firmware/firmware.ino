
byte eyes[4][866] = {
  {198, 152, 77, 119, 105, 90, 127, 227, 102, 102, 194, 127, 119,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 144, 206},
  {68, 81, 124, 194, 223, 155, 73, 223, 186, 127, 231, 177, 215,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 90, 161},
  {183, 206, 136, 65, 159, 115, 161, 90, 202, 81, 181, 90, 73,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 181, 90},
  {173, 187, 216, 236, 136, 130, 169, 119, 127, 119, 165, 206, 165,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 173, 56},
 };

int pins[] = {14, 15, 16, 17};
int counters[] = {eyes[0][0], eyes[1][0], eyes[2][0], eyes[3][0]};
int indices[] = {0, 0, 0, 0};
int arraySize = 866;

const int changeTime = 12;
unsigned long lastTime;

void setup() {
  for (int i=0; i<4; i++) {
    pinMode(pins[i], OUTPUT);
    digitalWrite(pins[i], LOW);
  }
}

void loop() {
  if (changeTime < millis() - lastTime) {
    for (int i=0; i<4; i++) {
      counters[i]--;
      if (counters[i] == 0) {
        digitalWrite(pins[i], HIGH);
        delay(10);
        digitalWrite(pins[i], LOW);
        indices[i];
        if (indices[i] == arraySize) {
          indices[i] = 0;
        }
        counters[i] = eyes[i][indices[i]];
      }
    }
    lastTime = millis(); 
  }
}
  
  
